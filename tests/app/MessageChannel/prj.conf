## CMakeLists.txt
```
cmake_minimum_required(VERSION 3.20.0)
find_package(Zephyr REQUIRED HINTS $ENV{ZEPHYR_BASE})

project(messageChannelTests)

target_include_directories(app PRIVATE ${CMAKE_CURRENT_SOURCE_DIR}/../../../app/include)

FILE(GLOB app_sources src/*.cpp)
target_sources(app PRIVATE ${app_sources})

target_link_libraries(app
PUBLIC
    myLib
    embeddedProto
)
```

## prj.conf
```kconfig
CONFIG_CPP=y
CONFIG_STD_CPP20=y

CONFIG_ZTEST=y

CONFIG_EMBEDDEDPROTO=y
CONFIG_MYLIB=y
```

## src/FramedWriteBuffer.cpp
```c
#include "FramedWriteBuffer.hpp"

#include <zephyr/ztest.h>

ZTEST_SUITE(framedWriteBuffer_tests, NULL, NULL, NULL, NULL, NULL);

ZTEST(framedWriteBuffer_tests, test_size)
{
    FramedWriteBuffer<32> buf;

    zassert_equal(buf.get_size(), 0);

    buf.push(42);
    zassert_equal(buf.get_size(), 1);

    buf.push(13);
    zassert_equal(buf.get_size(), 2);

    buf.push(13);
    zassert_equal(buf.get_size(), 3);
}

ZTEST(framedWriteBuffer_tests, test_frame)
{
    FramedWriteBuffer<32> buf;

    buf.push(42);
    buf.push(13);

    const auto ret = buf.frame();
    zassert_equal(ret.size(), 3);
    zassert_equal(ret[0], 2);
    zassert_equal(ret[1], 42);
    zassert_equal(ret[2], 13);
}
```

## src/FramerTests.cpp
```c
#include "Framer.hpp"

#include <zephyr/ztest.h>

#include <array>

template <typename T, std::size_t SIZE_V>
class WriteBuf {
  public:
    bool push(T item) noexcept
    {
        if (size() >= SIZE_V) {
            return false;
        }

        _buf[_idx++] = item;
        return true;
    }

    void clear() noexcept { _idx = 0; }
    std::size_t size() const noexcept { return _idx; }
    T get(std::size_t i) const noexcept { return _buf[i]; }

  private:
    std::size_t _idx{};
    std::array<T, SIZE_V> _buf{};
};

ZTEST_SUITE(framer_tests, NULL, NULL, NULL, NULL, NULL);

ZTEST(framer_tests, test_init_msgNotComplete)
{
    WriteBuf<std::uint8_t, 32> buf;
    Framer framer(buf);

    zassert_false(framer.msgComplete());
}

ZTEST(framer_tests, test_deframe_msgCompleteSet)
{
    WriteBuf<std::uint8_t, 32> buf;
    Framer framer(buf);

    framer.deframe(2);
    zassert_false(framer.msgComplete());

    framer.deframe(5);
    zassert_false(framer.msgComplete());

    framer.deframe(8);
    zassert_true(framer.msgComplete());
}

ZTEST(framer_tests, test_deframe_bufDataCorrect)
{
    WriteBuf<std::uint8_t, 32> buf;
    Framer framer(buf);

    framer.deframe(2);
    framer.deframe(5);
    framer.deframe(8);

    zassert_equal(buf.size(), 2);
    zassert_equal(buf.get(0), 5);
    zassert_equal(buf.get(1), 8);
}
```
