## CMakeLists.txt
```
# Copyright (c) 2021, Legrand North America, LLC.
# SPDX-License-Identifier: Apache-2.0

cmake_minimum_required(VERSION 3.20.0)
find_package(Zephyr REQUIRED HINTS $ENV{ZEPHYR_BASE})

project(myLib_tests)

FILE(GLOB app_sources src/*.cpp)
target_sources(app PRIVATE ${app_sources})

target_link_libraries(app PRIVATE myLib)
```

## prj.conf
```kconfig
CONFIG_ZTEST=y
CONFIG_MYLIB=y
```

## src/FramerTests.cpp
```c
#include <myLib/Framer.hpp>

#include <zephyr/ztest.h>

#include <array>

template <typename T, std::size_t SIZE_V>
class WriteBuf {
  public:
    bool push(T item) noexcept
    {
        if (size() >= SIZE_V) {
            return false;
        }

        _buf[_idx++] = item;
        return true;
    }

    void clear() noexcept { _idx = 0; }
    std::size_t size() const noexcept { return _idx; }
    T get(std::size_t i) const noexcept { return _buf[i]; }

  private:
    std::size_t _idx{};
    std::array<T, SIZE_V> _buf{};
};

ZTEST_SUITE(framer_tests, NULL, NULL, NULL, NULL, NULL);

// ZTEST(framer_tests, test_init_msgNotComplete)
// {
//     myLib::RingBuffer<std::uint8_t, 32> buf;
//     Framer framer(buf);

//     zassert_false(framer.msgComplete());
// }

ZTEST(framer_tests, test_deframe_msgCompleteSet)
{
    WriteBuf<std::uint8_t, 32> buf;
    Framer framer(buf);

    framer.deframe(2);
    zassert_false(framer.msgComplete());

    framer.deframe(5);
    zassert_false(framer.msgComplete());

    framer.deframe(8);
    zassert_true(framer.msgComplete());
}

ZTEST(framer_tests, test_deframe_bufDataCorrect)
{
    WriteBuf<std::uint8_t, 32> buf;
    Framer framer(buf);

    framer.deframe(2);
    framer.deframe(5);
    framer.deframe(8);

    zassert_equal(buf.size(), 2);
    zassert_equal(buf.get(0), 5);
    zassert_equal(buf.get(1), 8);
}
```

## src/RingBuffertTests.cpp
```c
#include <myLib/RingBuffer.hpp>

#include <zephyr/ztest.h>

ZTEST_SUITE(ringBuffer_tests, NULL, NULL, NULL, NULL, NULL);

ZTEST(ringBuffer_tests, test_index_prefix_increment_decrement)
{
    myLib::internal::RingIndex<4> idx;

    zassert_equal(idx, 0);
    zassert_equal(++idx, 1);
    zassert_equal(++idx, 2);

    zassert_equal(idx, 2);
    zassert_equal(--idx, 1);
    zassert_equal(--idx, 0);
}

ZTEST(ringBuffer_tests, test_index_postfix_increment_decrement)
{
    myLib::internal::RingIndex<4> idx;

    zassert_equal(idx++, 0);
    zassert_equal(idx++, 1);
    zassert_equal(idx, 2);

    zassert_equal(idx--, 2);
    zassert_equal(idx--, 1);
    zassert_equal(idx, 0);
}

ZTEST(ringBuffer_tests, test_index_increment_wraparound)
{
    static constexpr std::size_t size = 3;
    myLib::internal::RingIndex<size> idx;

    for (unsigned int i = 0; i < (size - 1); ++i) {
        ++idx;
    }
    zassert_equal(idx, size - 1, "is: %d", idx);
    ++idx;
    zassert_equal(idx, 0);
}

ZTEST(ringBuffer_tests, test_index_increment_wraparound_powerOf2)    // TODO ??
{
    static constexpr std::size_t size = 8;
    myLib::internal::RingIndex<size> idx;

    for (unsigned int i = 0; i < (size - 1); ++i) {
        ++idx;
    }
    zassert_equal(idx, size - 1);
    ++idx;
    zassert_equal(idx, 0);
}

ZTEST(ringBuffer_tests, test_index_decrement_wraparound)
{
    static constexpr std::size_t size = 8;
    myLib::internal::RingIndex<size> idx;

    --idx;
    zassert_equal(idx, size - 1);
}

ZTEST(ringBuffer_tests, test_buffer_empty)
{
    myLib::RingBuffer<int, 8> buf;

    zassert_true(buf.isEmpty());

    buf.push(42);
    zassert_false(buf.isEmpty());

    buf.pull();
    zassert_true(buf.isEmpty());
}

ZTEST(ringBuffer_tests, test_empty_pull)
{
    myLib::RingBuffer<int, 8> buf;

    zassert_true(buf.isEmpty());

    const auto ret = buf.pull();
    zassert_false(ret.has_value());
}

ZTEST(ringBuffer_tests, test_buffer_full)
{
    myLib::RingBuffer<int, 4> buf;

    zassert_false(buf.isFull());

    buf.push(42);
    zassert_false(buf.isFull());
    buf.push(42);
    zassert_false(buf.isFull());

    buf.push(42);
    zassert_true(buf.isFull());

    buf.pull();
    zassert_false(buf.isFull());

    buf.push(42);
    zassert_true(buf.isFull());
}

ZTEST(ringBuffer_tests, test_cnt)
{
    myLib::RingBuffer<int, 8> buf;

    unsigned int i = 0;
    while (!buf.isFull()) {
        zassert_equal(buf.cnt(), i);
        buf.push(86);
        ++i;
    }

    while (!buf.isEmpty()) {
        zassert_equal(buf.cnt(), i, "%d vs %d", buf.cnt(), i);
        buf.pull();
        --i;
    }
}

ZTEST(ringBuffer_tests, test_push_and_pull)
{
    {
        myLib::RingBuffer<int, 8> buf;

        zassert_true(buf.push(42));
        zassert_equal(buf.pull(), 42);
    }
}

ZTEST(ringBuffer_tests, test_wraparound)
{
    myLib::RingBuffer<int, 4> buf;

    zassert_true(buf.isEmpty());

    zassert_true(buf.push(5));
    zassert_true(buf.push(30));
    zassert_true(buf.push(186));

    zassert_true(buf.isFull());

    zassert_equal(buf.pull(), 5);
    zassert_equal(buf.pull(), 30);

    zassert_true(buf.push(99));
    zassert_true(buf.push(369));

    zassert_true(buf.isFull());

    zassert_equal(buf.pull(), 186);
    zassert_equal(buf.pull(), 99);
    zassert_equal(buf.pull(), 369);

    zassert_true(buf.isEmpty());
}

ZTEST(ringBuffer_tests, test_items_order)
{
    const std::array<int, 4> expected = {1, 2, 3, 4};

    myLib::RingBuffer<int, 4> buf;

    for (int v : expected) {
        buf.push(v);
    }

    std::array<int, 4> actual;
    for (int& v : actual) {
        v = buf.pull().value_or(0);
    }

    zassert_mem_equal(expected.data(), actual.data(), expected.size());
}
```
