## boards/arm/serial_temp_sens/Kconfig.board
```kconfig
# Copyright (c) 2021 Nordic Semiconductor ASA
# SPDX-License-Identifier: Apache-2.0

config BOARD_SERIAL_TEMP_SENS
	bool "Serial TempSens Board"
	depends on SOC_STM32G0B1XX
```

## boards/arm/serial_temp_sens/Kconfig.defconfig
```kconfig
# Copyright (c) 2021 Nordic Semiconductor ASA
# SPDX-License-Identifier: Apache-2.0

if BOARD_SERIAL_TEMP_SENS

config BOARD
	default "serial_temp_sens"

endif # BOARD_SERIAL_TEMP_SENS
```

## boards/arm/serial_temp_sens/serial_temp_sens_defconfig
```kconfig
# Copyright (c) 2021 Nordic Semiconductor ASA
# SPDX-License-Identifier: Apache-2.0

CONFIG_SOC_SERIES_STM32G0X=y
CONFIG_SOC_STM32G0B1XX=y

CONFIG_ARM_MPU=y

CONFIG_GPIO=y
CONFIG_CLOCK_CONTROL=y
CONFIG_PINCTRL=y
```

## tests/app/SensorService/testcase.yaml
```yaml
common:
  tags: extensibility
  integration_platforms:
    - native_posix
tests:
  app.sensorService: {}
```

## tests/lib/myLib/testcase.yaml
```yaml
common:
  tags: extensibility
  integration_platforms:
    - serial_temp_sens
    - native_posix
tests:
  lib.myLib: {}
```

## west.yml
```yaml
# Copyright (c) 2021 Nordic Semiconductor ASA
# SPDX-License-Identifier: Apache-2.0

manifest:
  self:
    west-commands: scripts/west-commands.yml

  remotes:
    - name: zephyrproject-rtos
      url-base: https://github.com/zephyrproject-rtos
    - name: embedded-ams
      url-base: https://github.com/Embedded-AMS/

  projects:
    - name: zephyr
      remote: zephyrproject-rtos
      revision: 2d060feb51accfd31a797d178287682e208ce16c
      import:
        name-allowlist:
          - cmsis
          - hal_stm32

    - name: EmbeddedProto
      remote: embedded-ams
      revision: 3.4.2
      submodules: true
      path: modules/EmbeddedProto
```
